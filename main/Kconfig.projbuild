## main/Kconfig.projbuild
```kconfig
menu "IPC Internet"

    choice APP_NETIF
        prompt "Network interface"
        default APP_NETIF_ETH
        help
            Connectivity for the WebRTC stream: wired Ethernet, or Wi-Fi via the
            esp_wifi_remote / esp_hosted co-processor (e.g. ESP32-C6 over SDIO).

        config APP_NETIF_ETH
            bool "Ethernet"

        config APP_NETIF_WIFI
            bool "Wi-Fi (esp_wifi_remote)"
            select ESP_HOSTED_ENABLED
            help
                Selects ESP_HOSTED_ENABLED so the esp_hosted host driver is compiled
                in. On Ethernet builds it stays off (see sdkconfig.defaults): its
                initialiser is a global constructor that claims internal DMA RAM
                before app_main and asserts if the allocation fails.
    endchoice

        if APP_NETIF_ETH
            config ESP_ETH_PHY_ADDR
                int "Ethernet PHY Address"
                default 1
                help
                    The address of the Ethernet PHY on the MDIO bus.

            config ESP_ETH_PHY_RST_GPIO
                int "Ethernet PHY Reset GPIO"
                default 51
                help
                    The GPIO pin number used to reset the Ethernet PHY.

            config ESP_ETH_MDC_GPIO
                int "Ethernet MDC GPIO"
                default 31
                help
                    The GPIO pin number used for the Ethernet MDC line.

            config ESP_ETH_MDIO_GPIO
                int "Ethernet MDIO GPIO"
                default 52
                help
                    The GPIO pin number used for the Ethernet MDIO line.
        endif

        # Deliberately NOT inside "if APP_NETIF_WIFI". Kconfig does not write
        # invisible symbols to sdkconfig, so gating these on the netif choice made
        # them vanish the moment Ethernet was selected -- and switching back gave
        # the defaults below rather than the credentials that were there before.
        # Keeping them always visible is what lets the two builds live side by
        # side. hal_netif.c only reads them under #if CONFIG_APP_NETIF_WIFI, so on
        # an Ethernet build they are two unused strings and nothing more.
        config ESP_WIFI_SSID
            string "WiFi SSID"
            default "myssid"
            help
                SSID (network name) for the app to connect to.
                Ignored unless the network interface above is Wi-Fi.

        config ESP_WIFI_PASSWORD
            string "WiFi Password"
            default "mypassword"
            help
                WiFi password (WPA or WPA2) for the app to use.
                Ignored unless the network interface above is Wi-Fi.

endmenu

menu "IPC Wertc"

    config SIGNALING_URL
        string "Signaling URL"
        default "https://libpeer.com/public/test"
        help
            Enter the URL of the Peer library to use.

    config SIGNALING_TOKEN
        string "Signaling Token"
        default ""
        help
            Enter the token of the Peer library to use.

    config STUN_URL
        string "STUN URL"
        default "stun.l.google.com:19302"
        help
            Enter the URL of STUN server.

    menuconfig TURN
        bool "Enable TURN"
        default n
        help
            Enable this if the device is behind a restrictive NAT and cannot connect to peers with STUN alone.

        if TURN
            config TURN_URL
                string "TURN URL"
                default "turn:openrelay.metered.ca:80"
                help
                    Enter the URL of TURN server.

            config TURN_USERNAME
                string "TURN Username"
                default "openrelayproject"
                help
                    Enter the username for TURN server authentication.

            config TURN_CREDENTIAL
                string "TURN Credential"
                default "openrelayproject"
                help
                    Enter the crdential for TURN server authentication.
        endif

endmenu

menu "IPC Features"

    config APP_ENABLE_AI
        bool "Enable pedestrian detection (AI)"
        default y
        help
            Run the esp-dl pedestrian detector and overlay boxes on the stream.
            Disable to free internal RAM (the esp-dl model is never instantiated),
            e.g. when Wi-Fi/esp_hosted is enabled and internal DMA RAM is tight.
        
endmenu

menu "IPC Video"

    config APP_MIPI_CSI_SCCB_I2C_PORT
        int "MIPI CSI SCCB I2C Port"
        default 0
        help
            The I2C port number used for the MIPI CSI SCCB interface.
    
    config APP_MIPI_CSI_SCCB_I2C_SCL_PIN
        int "MIPI CSI SCCB I2C SCL Pin"
        default 8
        help
            The GPIO pin number used for the MIPI CSI SCCB I2C SCL line.

    config APP_MIPI_CSI_SCCB_I2C_SDA_PIN
        int "MIPI CSI SCCB I2C SDA Pin"
        default 7
        help
            The GPIO pin number used for the MIPI CSI SCCB I2C SDA line.

    config APP_MIPI_CSI_SCCB_I2C_FREQ
        int "MIPI CSI SCCB I2C Frequency"
        default 100000
        help
            The frequency (in Hz) of the MIPI CSI SCCB I2C interface.

    config APP_MIPI_CSI_SENSOR_RESET_PIN
        int "MIPI CSI Sensor Reset Pin"
        default -1
        help
            The GPIO pin number used for the MIPI CSI sensor reset line.

    config APP_MIPI_CSI_SENSOR_PWDN_PIN
        int "MIPI CSI Sensor Power Down Pin"
        default -1
        help
            The GPIO pin number used for the MIPI CSI sensor power down line.

endmenu

menu "IPC Audio"

    config APP_AUDIO_I2C_NUM
        int "Audio I2C Port"
        default 0
        help
            The I2C port number used for the audio codec.
    
    config APP_AUDIO_I2S_NUM
        int "Audio I2S Port"
        default 0
        help
            The I2S port number used for audio input/output.

    config APP_AUDIO_I2C_SCL_IO
        int "Audio I2C SCL Pin"
        default 8
        help
            The GPIO pin number used for the audio codec I2C SCL line.

    config APP_AUDIO_I2C_SDA_IO
        int "Audio I2C SDA Pin"
        default 7
        help
            The GPIO pin number used for the audio codec I2C SDA line.

    config APP_AUDIO_I2S_MCK_IO
        int "Audio I2S MCK Pin"
        default 13
        help
            The GPIO pin number used for the audio codec I2S MCK line.

    config APP_AUDIO_I2S_BCK_IO
        int "Audio I2S BCK Pin"
        default 12
        help
            The GPIO pin number used for the audio codec I2S BCK line.

    config APP_AUDIO_I2S_WS_IO
        int "Audio I2S WS Pin"
        default 10
        help
            The GPIO pin number used for the audio codec I2S WS line.
    
    config APP_AUDIO_I2S_DO_IO
        int "Audio I2S DO Pin"
        default 9
        help
            The GPIO pin number used for the audio codec I2S DO line.

    config APP_AUDIO_I2S_DI_IO
        int "Audio I2S DI Pin"
        default 11
        help
            The GPIO pin number used for the audio codec I2S DI line.

    config APP_AUDIO_PA_IO
        int "Audio PA Pin"
        default 53
        help
            The GPIO pin number used for the audio power amplifier.

    config APP_AUDIO_SAMPLE_RATE
        int "Audio Sample Rate"
        default 8000
        help
            The sample rate (in Hz) for audio input/output.

    config APP_AUDIO_MCLK_MULTIPLE
        int "Audio MCLK Multiple"
        default 384
        help
            The multiple of the sample rate used to generate the audio master clock (MCLK).

    config APP_AUDIO_VOLUME
        int "Speaker volume (0-100)"
        range 0 100
        default 70
        help
            Output level of the ES8311 DAC, applied once at init. Drives both
            halves of what comes out of the speaker: the WebRTC downlink from the
            browser, and the power-on tone below.

    config APP_AUDIO_MIC_GAIN_DB
        string "Microphone gain (dB)"
        default "30.0"
        help
            Gain applied to the ES8311 ADC ahead of the WebRTC uplink. A string
            rather than an int because the codec takes a float; hal_audio.c
            parses it with strtof().

            Raise it if the far end hears the room too faintly, but note that it
            amplifies the speaker's own output back into the microphone as well
            -- there is no echo canceller in this path, so a device with the
            speaker and microphone close together will howl before it gets loud.

    config APP_AUDIO_WELCOME_TONE
        bool "Play a tone at power-on"
        default y
        help
            Plays a short rising arpeggio once the audio codec is up, which on
            this board is after the network has an IP -- so hearing it means the
            camera has finished booting and is reachable, not merely powered.

            Synthesised at runtime from three sine tones, so it costs no flash
            and no PSRAM. Turn it off for a silent install.

endmenu
```
